#include "Display.h"

// Printable ASCII, 5 columns per glyph. Kept in flash so the display driver has
// no external library dependency.
static const uint8_t kFont[] PROGMEM = {
0x00,0x00,0x00,0x00,0x00,0x00,0x00,0x5f,0x00,0x00,0x00,0x07,0x00,0x07,0x00,0x14,0x7f,0x14,0x7f,0x14,
0x24,0x2a,0x7f,0x2a,0x12,0x23,0x13,0x08,0x64,0x62,0x36,0x49,0x55,0x22,0x50,0x00,0x05,0x03,0x00,0x00,
0x00,0x1c,0x22,0x41,0x00,0x00,0x41,0x22,0x1c,0x00,0x14,0x08,0x3e,0x08,0x14,0x08,0x08,0x3e,0x08,0x08,
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0x00,0x00,0x7f,0x00,0x00,0x00,0x41,0x36,0x08,0x00,0x10,0x08,0x08,0x10,0x08
};

bool PuckDisplay::begin() {
  Wire.begin(Hardware::PIN_OLED_SDA, Hardware::PIN_OLED_SCL);
  Wire.setClock(400000);
  Wire.beginTransmission(Hardware::OLED_ADDRESS);
  if (Wire.endTransmission() != 0) return false;
#if defined(OLED_CONTROLLER_SSD1306)
  const uint8_t init[] = {0xAE,0xD5,0x80,0xA8,0x3F,0xD3,0x00,0x40,0x8D,0x14,0x20,0x00,0xA1,0xC8,0xDA,0x12,0x81,0x7F,0xD9,0xF1,0xDB,0x40,0xA4,0xA6,0xAF};
#else
  const uint8_t init[] = {0xAE,0xD5,0x80,0xA8,0x3F,0xD3,0x00,0x40,0xAD,0x8B,0xA1,0xC8,0xDA,0x12,0x81,0x7F,0xD9,0x22,0xDB,0x35,0xA4,0xA6,0xAF};
#endif
  for (uint8_t value : init) command(value);
  clear(); show();
  return true;
}

void PuckDisplay::command(uint8_t value) {
  Wire.beginTransmission(Hardware::OLED_ADDRESS); Wire.write(0x00); Wire.write(value); Wire.endTransmission();
}

void PuckDisplay::data(const uint8_t* bytes, size_t length) {
  while (length) {
    // ESP32-C3 Wire supports this comfortably. Larger chunks halve the
    // transaction overhead of a complete 128x64 frame and leave more CPU time
    // for input handling and networking.
    const size_t chunk = min(length, static_cast<size_t>(32));
    Wire.beginTransmission(Hardware::OLED_ADDRESS); Wire.write(0x40); Wire.write(bytes, chunk); Wire.endTransmission();
    bytes += chunk; length -= chunk;
  }
}

void PuckDisplay::clear() { memset(buffer_, 0, sizeof(buffer_)); }

void PuckDisplay::show() {
  // Most UI frames remain identical between the 70 ms render ticks. Sending
  // the same 1024 bytes again blocks the main loop for several milliseconds
  // and makes the encoder and LEDs feel jerky. Keep the rendering cadence for
  // toast/time-out transitions, but touch I2C only when pixels really changed.
  if (hasSentFrame_ && memcmp(buffer_, sentBuffer_, sizeof(buffer_)) == 0) return;
  for (uint8_t page = 0; page < 8; ++page) {
#if defined(OLED_CONTROLLER_SSD1306)
    command(0xB0 + page); command(0x00); command(0x10);
#else
    command(0xB0 + page); command(0x02); command(0x10);
#endif
    data(buffer_ + page * Hardware::OLED_WIDTH, Hardware::OLED_WIDTH);
  }
  memcpy(sentBuffer_, buffer_, sizeof(buffer_));
  hasSentFrame_ = true;
}

void PuckDisplay::setContrast(uint8_t value) {
  command(0x81);
  command(value);
}
void PuckDisplay::sleep(bool enabled) { command(enabled ? 0xAE : 0xAF); }
void PuckDisplay::invert(bool enabled) { command(enabled ? 0xA7 : 0xA6); }

void PuckDisplay::pixel(int16_t x, int16_t y, bool on) {
  // The visible matrix in this module sits slightly to the right of the
  // controller's logical origin. Shift the complete UI by two pixels.
  x += 2;
  if (x < 0 || y < 0 || x >= 128 || y >= 64) return;
  uint8_t& value = buffer_[x + (y / 8) * 128];
  const uint8_t mask = 1u << (y & 7);
  if (on) value |= mask; else value &= ~mask;
}

void PuckDisplay::line(int16_t x0, int16_t y0, int16_t x1, int16_t y1) {
  int16_t dx = abs(x1-x0), sx = x0<x1 ? 1 : -1, dy = -abs(y1-y0), sy = y0<y1 ? 1 : -1, error = dx+dy;
  while (true) { pixel(x0,y0); if (x0==x1 && y0==y1) break; int16_t e2=2*error; if(e2>=dy){error+=dy;x0+=sx;} if(e2<=dx){error+=dx;y0+=sy;} }
}

void PuckDisplay::rect(int16_t x, int16_t y, int16_t w, int16_t h, bool fill) {
  if (fill) { for (int16_t yy=y; yy<y+h; ++yy) for (int16_t xx=x; xx<x+w; ++xx) pixel(xx,yy); }
  else { line(x,y,x+w-1,y); line(x,y+h-1,x+w-1,y+h-1); line(x,y,x,y+h-1); line(x+w-1,y,x+w-1,y+h-1); }
}

void PuckDisplay::character(int16_t x, int16_t y, char value, uint8_t scale) {
  if (value < 32 || value > 126) value = '?';
  const uint16_t offset = (value - 32) * 5;
  for (uint8_t column=0; column<5; ++column) {
    uint8_t bits = pgm_read_byte(kFont + offset + column);
    for (uint8_t row=0; row<7; ++row) if (bits & (1u<<row))
      for (uint8_t sx=0;sx<scale;++sx) for(uint8_t sy=0;sy<scale;++sy) pixel(x+column*scale+sx,y+row*scale+sy);
  }
}

void PuckDisplay::text(int16_t x, int16_t y, const String& value, uint8_t scale) { for (char ch : value) { character(x,y,ch,scale); x += 6*scale; } }
int16_t PuckDisplay::textWidth(const String& value, uint8_t scale) const { return value.length() ? value.length()*6*scale- scale : 0; }
void PuckDisplay::centered(int16_t y, const String& value, uint8_t scale) { text(max(0,(126-textWidth(value,scale))/2),y,value,scale); }

void PuckDisplay::characterMedium(int16_t x, int16_t y, char value) {
  if (value < 32 || value > 126) value = '?';
  const uint16_t offset = static_cast<uint16_t>(value - 32) * 5;
  uint8_t columns[5];
  for (uint8_t column = 0; column < 5; ++column)
    columns[column] = pgm_read_byte(kFont + offset + column);

  // Same 8x14 shape as before, but overlapping 1.5x columns are merged first
  // instead of writing several pixels twice.
  for (uint8_t row = 0; row < 7; ++row) {
    const uint8_t bit = 1U << row;
    const bool expanded[8] = {
      static_cast<bool>(columns[0] & bit),
      static_cast<bool>((columns[0] | columns[1]) & bit),
      static_cast<bool>(columns[1] & bit),
      static_cast<bool>(columns[2] & bit),
      static_cast<bool>((columns[2] | columns[3]) & bit),
      static_cast<bool>(columns[3] & bit),
      static_cast<bool>(columns[4] & bit),
      static_cast<bool>(columns[4] & bit)
    };
    for (uint8_t dx = 0; dx < 8; ++dx) {
      if (!expanded[dx]) continue;
      pixel(x + dx, y + row * 2);
      pixel(x + dx, y + row * 2 + 1);
    }
  }
}

void PuckDisplay::textMedium(int16_t x, int16_t y, const String& value) {
  for (char ch : value) {
    characterMedium(x, y, ch);
    x += 9;
  }
}

int16_t PuckDisplay::textWidthMedium(const String& value) const {
  return value.length() ? static_cast<int16_t>(value.length() * 9 - 1) : 0;
}

void PuckDisplay::centeredMedium(int16_t y, const String& value) {
  textMedium(max(0, (126 - textWidthMedium(value)) / 2), y, value);
}

void PuckDisplay::progress(int16_t x,int16_t y,int16_t w,int16_t h,uint8_t percent) { rect(x,y,w,h); int16_t fill=(w-4)*min(percent,(uint8_t)100)/100; if(fill>0)rect(x+2,y+2,fill,h-4,true); }
